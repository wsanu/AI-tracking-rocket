## px4_tracker_integration/src/modules/track_control/Kconfig
```kconfig
menuconfig MODULES_TRACK_CONTROL
	bool "track_control"
	default n
	---help---
		TRACK flight-mode attitude setpoint generator. Keeps an upward-mounted
		camera optical axis pointed at tracker_target while RC yaw commands
		twist and RC throttle commands total thrust.
```

## px4_tracker_integration/src/modules/uart_tracker/Kconfig
```kconfig
menuconfig MODULES_UART_TRACKER
	bool "uart_tracker"
	default n
	---help---
		UART based target tracker parser. Reads target information from a
		closed vision/tracking module and publishes tracker_target uORB data.
```
